## conf/layer.conf
```bitbake
# We have a conf and classes directory, add to BBPATH
BBPATH .= ":${LAYERDIR}"

# We have recipes-* directories, add to BBFILES
BBFILES += "${LAYERDIR}/recipes-*/*/*.bb \
            ${LAYERDIR}/recipes-*/*/*.bbappend"

BBFILE_COLLECTIONS += "meta-qt-weed"
BBFILE_PATTERN_meta-qt-weed = "^${LAYERDIR}/"
BBFILE_PRIORITY_meta-qt-weed = "6"

LAYERDEPENDS_meta-qt-weed = "core"
LAYERSERIES_COMPAT_meta-qt-weed = "dunfell"
```
